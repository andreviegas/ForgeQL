AUTOSAR XML (schema 00046)
package /ActiveEcuC
  module config CanIf
    CanIfPublicCfg: CanIfPublicTxBuffering=true, CanIfPublicMaxTxBuffers=8, CanIfPublicHandleTypeEnum=UINT16
    CanIfInitCfg: CanIfMaxBufferSize=64
      CanIfBufferCfg_0 (CanIfBufferCfg): CanIfBufferSize=16, CanIfBufferHthIdRef=CanIfHthCfg_0
      CanIfHthCfg_0 (CanIfHthCfg): CanIfHthIdSymRef=0
