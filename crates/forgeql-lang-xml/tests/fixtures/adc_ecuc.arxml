AUTOSAR XML (schema 4.0)
package /ActiveEcuC
  module config Adc
    AdcConfigSet ()
      AdcHwUnit_0 (): AdcPrescale=4, AdcPriority=0
